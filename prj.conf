## west.yml
```
manifest:
  version: 0.7
 
  defaults:
    remote: zephyrproject
  remotes:
    - name: zephyrproject
      url-base: https://github.com/zephyrproject-rtos
  group-filter: [+optional]
  projects:
    - name: zephyr
      repo-path: zephyr
      revision: main
      import:
        path-prefix: deps
        name-allowlist:
          - cmsis
          - hal_stm32
          - nanopb
      path: zephyr
    - name: nanopb-module
      url: https://github.com/sageve/nanopb-module
      path: deps/modules/nanopb-module
      revision: main
  self:
    path: app
```

## prj.conf
```kconfig
# nothing here
CONFIG_NANOPB_TEST=y
```

## src/main.c
```c
/*
 * Copyright (c) 2012-2014 Wind River Systems, Inc.
 *
 * SPDX-License-Identifier: Apache-2.0
 */

#include <stdio.h>

#include <nanopb_test.h>

int main(void)
{
	printf("Hello World! %s\n", CONFIG_BOARD_TARGET);

	nanopb_test();

	return 0;
}
```
